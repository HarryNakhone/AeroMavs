## west.yml
```yaml
manifest:
  version: "0.13"
  defaults:
    remote: upstream

  remotes:
    - name: upstream
      url-base: https://github.com/zephyrproject-rtos

  projects:
    - name: zephyr
      remote: upstream
      revision: v3.6.0
      import: true

  self:
    path: custom_driver
```
